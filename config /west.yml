## config /west.yml
```yaml
manifest:
  remotes:
    - name: nazuna293
      url-base: https://github.com/nazuna293
  projects:
    - name: zmk-keyboard-Enigma_03
      remote: nazuna293
      revision: v1.0
      import: config/west.yml
  self:
    path: config
```
